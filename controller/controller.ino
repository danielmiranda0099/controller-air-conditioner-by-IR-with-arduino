#include <IrSenderPwm.h>


static constexpr pin_t PIN = 3U;

static const microseconds_t signal_ON[] = {  505U, 17780U, 2988U, 8899U, 505U, 505U, 505U, 1444U, 505U, 505U, 505U, 505U, 505U,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 505U, 30008U };
static const microseconds_t signal_OFF[] = { 505U, 17760U, 2992U, 8893U, 505U, 505U, 505U, 1443U, 505U, 505U, 505U, 505U, 505U,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 505U, 30004U };

static const IrSequence irSequence_ON(signal_ON, sizeof(signal_ON) / sizeof(microseconds_t));
static const IrSequence irSequence_OFF(signal_OFF, sizeof(signal_OFF) / sizeof(microseconds_t));

static IrSender* irSender;



byte sensor = 8;

byte timeDoorOpen = 10;
unsigned long tiempoMillis = 0;
unsigned long contadorMillis = 1000;

boolean doorOpen;
boolean stateAir = true;

byte segundos = 0;


void setup(){
    Serial.begin(115200);

    pinMode(sensor, INPUT);

    irSender = IrSenderPwm::getInstance(true, PIN);
}



void loop(){
    tiempoMillis = millis();

    doorOpen = digitalRead(sensor);

    if(doorOpen && stateAir){
        deactivateAir();
    }

    if(!doorOpen && !stateAir){
        activateAir();
    }

    //timer();
}

void deactivateAir(){
    delay(10000);
    if(!digitalRead(sensor)) return;
    irSender->send(irSequence_OFF, 38000, 33);
    Serial.println("OFF AIR");
    stateAir = false;
}

void activateAir(){
    delay(10000);
    if(digitalRead(sensor)) return;
    irSender->send(irSequence_ON, 38000, 33);
    Serial.println("ON AIR");
    stateAir = true;
}







void timer(){
    if(tiempoMillis >= contadorMillis){
        segundos++;
        contadorMillis += 1000;
        if(segundos >= 60){
            segundos = 0;
        }
    }
}
